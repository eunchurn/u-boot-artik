## board/samsung/artik051/Kconfig
```kconfig
if TARGET_ARTIK051

config SYS_BOARD
	default "artik051"

config SYS_VENDOR
	default "samsung"

config SYS_CONFIG_NAME
	string "Board configuration name"
	default "artik051"
	help
	  This option contains information about board configuration name.
	  Based on this option include/configs/<CONFIG_SYS_CONFIG_NAME>.h header
	  will be used for board configuration.

config SECURE_BOOT
	bool "Enable Secure Boot"
	default n

endif
```

## board/samsung/artik05x/Kconfig
```kconfig
if TARGET_ARTIK05X

config SYS_BOARD
	default "artik05x"

config SYS_VENDOR
	default "samsung"

config SYS_CONFIG_NAME
	string "Board configuration name"
	default "artik05x"
	help
	  This option contains information about board configuration name.
	  Based on this option include/configs/<CONFIG_SYS_CONFIG_NAME>.h header
	  will be used for board configuration.

config SECURE_BOOT
	bool "Enable Secure Boot"
	default y

endif
```

## configs/artik051da_defconfig
```kconfig
CONFIG_ARM=y
CONFIG_SYS_CONFIG_NAME="artik051da"
CONFIG_ARCH_EXYNOS=y
CONFIG_ARCH_EXYNOS0=y
CONFIG_TARGET_ARTIK051=y
CONFIG_IDENT_STRING=""
CONFIG_DEFAULT_DEVICE_TREE="exynos0200-artik051da"
# CONFIG_ARCH_FIXUP_FDT is not set
CONFIG_SYS_PROMPT="U-BOOT > "
CONFIG_SUPPORT_OF_CONTROL=y
CONFIG_OF_CONTROL=y
CONFIG_OF_EMBED=y
CONFIG_DM=y
CONFIG_OF_TRANSLATE=y
CONFIG_REQUIRE_SERIAL_CONSOLE=y
CONFIG_SERIAL_PRESENT=y
CONFIG_DM_SERIAL=y
CONFIG_OF_LIBFDT=y
CONFIG_USE_TINY_PRINTF=y
CONFIG_HUSH_PARSER=y
# CONFIG_ARCH_FIXUP_FDT_MEMORY is not set

CONFIG_CMD_MEMORY=y
# CONFIG_CMD_BOOTD is not set
# CONFIG_CMD_BOOTM is not set
# CONFIG_CMD_BOOTZ is not set
# CONFIG_CMD_BOOTEFI is not set
# CONFIG_CMD_ELF is not set
# CONFIG_CMD_FDT is not set
CONFIG_CMD_RUN=y
# CONFIG_CMD_IMI is not set
# CONFIG_CMD_IMLS is not set
# CONFIG_CMD_XIMG is not set
# CONFIG_CMD_FPGA is not set
# CONFIG_CMD_NET is not set
# CONFIG_CMD_NFS is not set
CONFIG_CMD_SAVEENV=y
CONFIG_CMD_DM=y
# CONFIG_CMD_DEMO is not set
CONFIG_CMD_LOADB=y
# CONFIG_CMD_LOADS is not set
CONFIG_CMD_FLASH=y
CONFIG_CMD_GO=y
CONFIG_CMD_MISC=y
CONFIG_CMD_GPIO=y

CONFIG_MTD=y
CONFIG_EXYNOS0_FLASH=y

# CONFIG_DM_SPI is not set

# CONFIG_GENERATE_SMBIOS_TABLE is not set
# CONFIG_EFI_LOADER is not set

CONFIG_BOOTCOUNT_LIMIT=y
```
